## drivers/net/wireless/cywdhd/Kconfig
```kconfig
config CYWDHD
	tristate "Cypress FullMAC wireless cards support"
	---help---
	  This module adds support for wireless adapters based on
	  Broadcom FullMAC chipset.

config BCMDHD_FW_PATH
	depends on CYWDHD
	string "Firmware path"
	default "/lib/firmware/cyw43438.bin"
	---help---
	  Path to the firmware file.

config BCMDHD_NVRAM_PATH
	depends on CYWDHD
	string "NVRAM path"
	default "/lib/firmware/nvram.txt"
	---help---
	  Path to the calibration file.

config BCMDHD_WEXT
	bool "Enable WEXT support"
	depends on CYWDHD && CFG80211 = n
	select WIRELESS_EXT
	select WEXT_PRIV
	help
	  Enables WEXT support
```

## drivers/net/wireless/rdaw80211/Kconfig
```kconfig
#
# RdaMicro Wireless LAN device configuration
#
menuconfig RDA_WLAN
	bool "RdaMicro IEEE802.11bgn Wlan Chip driver"
	default n
	---help---
		Need to enable this for RDA Wlan Chip.

if RDA_WLAN
config RDA_WLAN_POWER
	bool "RdaMicro Wlan Chip PowerCtrl Support"
	depends on I2C
	default y
	---help---
	  This option enables PowerManager support for RdaMicro Wlan Chip.
	  Say Y if you want to control the chip power.

config RDAWFMAC
	tristate "Rdamicro IEEE802.11bgn embedded FullMac WLAN driver"
	depends on CFG80211
	depends on RDA_WLAN_POWER
	default m
	---help---
	  This module adds support for embedded wireless adapters based on
	  Rdamicro IEEE802.11bgn FullMAC chipsets. It has to work with at least
	  one of the bus interface support. If you choose to build a module,
	  it'll be called rdawfmac.ko.

if RDAWFMAC
config RDAWFMAC_SDIO
	bool "SDIO bus interface support for FullMac driver"
	depends on MMC
	depends on RDAWFMAC
	default y
	---help---
	  This option enables the SDIO bus interface support for Rdamicro
	  IEEE802.11bgn embedded FullMAC WLAN driver. Say Y if you want to
	  use the driver for a SDIO wireless card.

config RDAWFMAC_USB
	bool "USB bus interface support for FullMAC driver"
	depends on USB
	depends on RDAWFMAC
	default n
	---help---
	  This option enables the USB bus interface support for Rdamicro
	  IEEE802.11bgn embedded FullMAC WLAN driver. Say Y if you want to
	  use the driver for an USB wireless card.

config RDAWFMAC_RF_TEST
	bool "RDA5995 RF Test support"
	depends on RDAWFMAC
	default y
	---help---
	  This option enables the SDIO RF test support for Rdamicro
	  IEEE802.11bgn embedded FullMAC WLAN driver. Say Y if you want to
	  use this function for a RDA5995.

config RDAWDBG
	bool "RdaMicro driver debug functions"
	depends on RDAWFMAC
	default y
	---help---
	  Selecting this enables additional code for debug purposes.
endif # RDAWFMAC

endif # RDA_WLAN
```

## drivers/soc/sunxi/Kconfig
```kconfig
#
# Allwinner sunXi SoC drivers
#
config SUNXI_SUSPEND_TIMER_COMPENSATE
	bool "Using timer to compensate sleep time"
	default n
	depends on PM_SLEEP && ARCH_SUN8IW18
	help
	  This function will turn on timer0 to time the platform sleep
	  and compensate to the system time.


menuconfig SOC_SUNXI
	bool "SUNXI SoC drivers support"

if SOC_SUNXI

config SUNXI_SRAM
	tristate "Sunxi sram support"
	help
	  Say y here to enable the SRAM controller support. This
	  device is responsible on mapping the SRAM in the sunXi SoCs
	  whether to the CPU/DMA, or to the devices.

config SUNXI_SUSPEND
	tristate "Sunxi suspend support"
	default ARCH_SUNXI
	depends on PM_SLEEP
	help
	  Say y here to enable the sunxi standby support.

config SUNXI_SUSPEND_NONARISC
	tristate "Sunxi suspend support without arisc"
	depends on SUNXI_SUSPEND && !SUNXI_ARISC
	default !SUNXI_ARISC
	help
	  Say y here to enter standby without arisc.

source "drivers/soc/sunxi/arisc/Kconfig"
endif # SOC_SUNXI
```
